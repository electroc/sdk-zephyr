## boards/arm/gg_v4_0_1_nrf52840/Kconfig.board
```kconfig
# Copyright (c) 2023 Nordic Semiconductor ASA
# SPDX-License-Identifier: Apache-2.0

config BOARD_gg_v4_0_1_nrf52840
	bool "gg_v4_0_1_nrf52840"
	depends on SOC_NRF52840_QIAA
```

## boards/arm/gg_v4_0_1_nrf52840/Kconfig.defconfig
```kconfig
# Copyright (c) 2023 Nordic Semiconductor ASA
# SPDX-License-Identifier: Apache-2.0

if BOARD_gg_v4_0_1_nrf52840

config BOARD
	default "gg_v4_0_1_nrf52840"

config BT_CTLR
   default BT


##if USB_DEVICE_STACK

# Enable UART driver, needed for CDC ACM
##config SERIAL
##	default y

##endif # USB_DEVICE_STACK

endif
```

## boards/arm/gg_v4_0_1_nrf52840/gg_v4_0_1_nrf52840_defconfig
```kconfig
# Copyright (c) 2023 Nordic Semiconductor ASA
# SPDX-License-Identifier: Apache-2.0

CONFIG_SOC_SERIES_NRF52X=y
CONFIG_SOC_NRF52840_QIAA=y
CONFIG_BOARD_gg_v4_0_1_nrf52840=y

# Enable MPU
CONFIG_ARM_MPU=y

# Enable hardware stack protection
CONFIG_HW_STACK_PROTECTION=y

# Enable RTT
CONFIG_USE_SEGGER_RTT=n

# enable GPIO
CONFIG_GPIO=y

# enable uart driver
CONFIG_SERIAL=y

# enable console
CONFIG_CONSOLE=y
CONFIG_UART_CONSOLE=y
CONFIG_UART_INTERRUPT_DRIVEN=y

# additional board options
CONFIG_GPIO_AS_PINRESET=y

CONFIG_PINCTRL=y

CONFIG_I2S=n

# CONFIG_I2S_TEST_USE_I2S_DIR_BOTH=y
# ONFIG_I2S_TEST_USE_GPIO_LOOPBACK=y
# CONFIG_I2S_TEST_ALLOWED_DATA_OFFSET=2
```
